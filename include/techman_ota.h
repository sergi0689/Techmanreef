#pragma once
#include <ESP8266HTTPClient.h>
#include <ESP8266httpUpdate.h>
#include <Updater.h>
#include <WiFiClientSecureBearSSL.h>
#include <CertStoreBearSSL.h>
#if __has_include("techman_version.h")
#include "techman_version.h"
#endif
#ifndef TECHMAN_FW_VERSION
#define TECHMAN_FW_VERSION "bootstrap-1"
#endif
// Precomputed CA subject hashes and public keys. No PEM/DER parsing on the ESP.
// The dynamic trust callback uses a SHA-256 subject hash, as CertStoreBearSSL does.
struct TmAnchor { uint8_t hash[32]; uint8_t type,curve; uint16_t aLen,bLen; uint8_t a[512],b[4]; };
static const TmAnchor tmAnchors[] PROGMEM = {
  {{0xce,0x6a,0x17,0x2b,0x6d,0x7d,0xfe,0x6d,0x53,0x0d,0x6e,0xa7,0xcc,0x60,0x3e,0x42,0xf8,0x9e,0x83,0x6b,0xed,0x6f,0x19,0xe7,0x0f,0x12,0x85,0x4a,0x4e,0x5c,0x2d,0xb1},1,0,256,3,{0xbb,0x37,0xcd,0x34,0xdc,0x7b,0x6b,0xc9,0xb2,0x68,0x90,0xad,0x4a,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0x29,0x85},{0x01,0x00,0x01}},
  {{0xf6,0xdb,0x2f,0xbd,0x9d,0xd8,0x5d,0x92,0x59,0xdd,0xb3,0xc6,0xde,0x7d,0x7b,0x2f,0xec,0x3f,0x3e,0x0c,0xef,0x17,0x61,0xbc,0xbf,0x33,0x20,0x57,0x1e,0x2d,0x30,0xf8},1,0,512,3,{0xad,0xe8,0x24,0x73,0xf4,0x14,0x37,0xf3,0x9b,0x9e,0x2b,0x57,0x28,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0x43,0x4f},{0x01,0x00,0x01}},
  {{0xe6,0x59,0x01,0xf5,0xfc,0xfc,0x65,0xad,0xf5,0x9e,0xeb,0xbe,0xe3,0xd8,0xf7,0x02,0xa5,0xf4,0xfb,0x94,0x4f,0x2c,0x58,0x02,0x16,0x6b,0xc8,0xbc,0x74,0xc8,0x78,0x55},1,0,512,3,{0x80,0x12,0x65,0x17,0x36,0x0e,0xc3,0xdb,0x08,0xb3,0xd0,0xac,0x57,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0x82,0x0f},{0x01,0x00,0x01}},
  {{0x56,0xbd,0xb6,0x6f,0x42,0x2b,0xf3,0x47,0x49,0x59,0x0f,0x21,0xf2,0x27,0xde,0x10,0x93,0x33,0x15,0x22,0x4b,0x7b,0x3d,0x8f,0x77,0xbf,0x8b,0x41,0x82,0x14,0x6f,0xaf},2,24,97,0,{0x04,0x1a,0xac,0x54,0x5a,0xa9,0xf9,0x68,0x23,0xe7,0x7a,0xd5,0x24,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0x79,0x79},{}},
  {{0xd7,0xc1,0x4e,0x9b,0x9f,0xc7,0xc9,0x97,0xfa,0x64,0x91,0x5d,0xa8,0x09,0x32,0x58,0x6c,0x2a,0xb4,0x92,0x0a,0x96,0x24,0x6a,0xc2,0x79,0x11,0x03,0x03,0x0d,0x0b,0x54},1,0,512,3,{0x93,0xbe,0xd5,0x36,0x52,0x75,0xd8,0x01,0x23,0xa0,0x1c,0x47,0x42,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0x6d,0xcf},{0x01,0x00,0x01}},
  {{0xbf,0xa8,0xd3,0x63,0x91,0x56,0x8a,0xa3,0x6d,0x54,0xe6,0xe8,0x96,0xda,0x3b,0xbc,0x1f,0xe7,0xa9,0x74,0x2e,0xde,0x3a,0x12,0x3e,0xfb,0x00,0xc7,0x41,0x00,0x68,0x7f},2,24,97,0,{0x04,0x76,0xfa,0x99,0xa9,0x6e,0x20,0xed,0xf9,0xd7,0x77,0xe3,0x07,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0x43,0xa3},{}}
};
class TmCertStore : public BearSSL::CertStoreBase {
  TmAnchor selected{};
  br_x509_trust_anchor anchor{};
  static const br_x509_trust_anchor *lookup(void *ctx, void *hash, size_t len) {
    if(len!=32 || !ctx || !hash)return nullptr;
    TmCertStore *self=static_cast<TmCertStore*>(ctx);
    for(size_t i=0;i<sizeof(tmAnchors)/sizeof(tmAnchors[0]);++i){
      if(memcmp_P(hash,tmAnchors[i].hash,32)!=0)continue;
      memcpy_P(&self->selected,&tmAnchors[i],sizeof(TmAnchor));
      auto &a=self->anchor; auto &s=self->selected;
      memset(&a,0,sizeof(a));
      a.dn.data=s.hash;a.dn.len=32;a.flags=BR_X509_TA_CA;
      a.pkey.key_type=s.type;
      if(s.type==BR_KEYTYPE_RSA){
        a.pkey.key.rsa.n=s.a;a.pkey.key.rsa.nlen=s.aLen;
        a.pkey.key.rsa.e=s.b;a.pkey.key.rsa.elen=s.bLen;
      }else{
        a.pkey.key.ec.curve=s.curve;a.pkey.key.ec.q=s.a;a.pkey.key.ec.qlen=s.aLen;
      }
      return &a;
    }
    return nullptr;
  }
  static void release(void *,const br_x509_trust_anchor *) {}
public:
  void installCertStore(br_x509_minimal_context *ctx) override {
    br_x509_minimal_set_dynamic(ctx,this,lookup,release);
  }
};
struct TmSavedCredentials { uint32_t magic; char ssid[33];char wifi[65];char web[65];char ap[65];uint32_t crc; };
static TmSavedCredentials tmSaved;
static String tmState="no_comprobado",tmAvailable="";
static int tmHttpCode=0;
static String tmDiagnostic="pendiente";
static bool tmRequested=false,tmInstall=false,tmBusy=false;
static uint32_t tmLast=0;
static uint32_t tmCrc(const TmSavedCredentials &v){const uint8_t*p=(const uint8_t*)&v;uint32_t h=2166136261UL;for(size_t i=0;i<sizeof(v)-4;i++){h^=p[i];h*=16777619UL;}return h;}
static void tmCopy(char*d,size_t n,const char*s){memset(d,0,n);if(s)strncpy(d,s,n-1);}
static void tmCredentials(){
  EEPROM.get(2048,tmSaved);
  bool valid=tmSaved.magic==0x544D5231UL&&tmSaved.crc==tmCrc(tmSaved)
    && memchr(tmSaved.ssid,0,sizeof(tmSaved.ssid))&&memchr(tmSaved.wifi,0,sizeof(tmSaved.wifi))
    && memchr(tmSaved.web,0,sizeof(tmSaved.web))&&memchr(tmSaved.ap,0,sizeof(tmSaved.ap));
  if(!valid&&strlen(TECHMAN_WIFI_SSID)&&strcmp(TECHMAN_WEB_PASS,"CHANGE_ME_BEFORE_USE")!=0){
    memset(&tmSaved,0,sizeof(tmSaved));tmSaved.magic=0x544D5231UL;
    tmCopy(tmSaved.ssid,sizeof(tmSaved.ssid),TECHMAN_WIFI_SSID);
    tmCopy(tmSaved.wifi,sizeof(tmSaved.wifi),TECHMAN_WIFI_PASS);
    tmCopy(tmSaved.web,sizeof(tmSaved.web),TECHMAN_WEB_PASS);
    tmCopy(tmSaved.ap,sizeof(tmSaved.ap),TECHMAN_AP_PASS);
    tmSaved.crc=tmCrc(tmSaved);EEPROM.put(2048,tmSaved);EEPROM.commit();valid=true;
  }
  if(valid){STA_SSID=tmSaved.ssid;STA_PASS=tmSaved.wifi;WEB_PASS=tmSaved.web;AP_PASS=tmSaved.ap;}
}
static bool tmIsVersion(const String&s){if(s.length()!=12)return false;for(unsigned i=0;i<s.length();i++)if(!isxdigit((unsigned char)s[i]))return false;return true;}
static void tmRunCheck(bool install){
  Serial.printf("[TECHMAN OTA] Heap antes TLS=%u maxBlock=%u fragmentation=%u%%\n",ESP.getFreeHeap(),ESP.getMaxFreeBlockSize(),ESP.getHeapFragmentation());
  tmRequested=tmInstall=false;
  if(WiFi.status()!=WL_CONNECTED){tmState="sin_wifi";return;}
  if(time(nullptr)<1735689600L){tmState="sin_hora";return;}
  if(ESP.getFreeSketchSpace()<420000){tmState="sin_espacio";return;}
  if(ESP.getFreeHeap()<22000 || ESP.getMaxFreeBlockSize()<16000){
    tmState="ram_insuficiente_tls";return;
  }
  String base=TECHMAN_OTA_BASE_URL;
  if(!base.startsWith("https://")){tmState="sin_url";return;}
  if(install && (!tmIsVersion(tmAvailable) || tmAvailable==String(TECHMAN_FW_VERSION))) {
    tmState="buscar_primero";Serial.println("[TECHMAN OTA] Pulsa Buscar antes de instalar");return;
  }
  // Al instalar NO volver a consultar el manifiesto, que fragmenta el heap.
  if(!install){
  // Mantener la conexion TLS del manifiesto en su propio ambito.
  // El cliente HTTPS y su memoria DEBEN liberarse ANTES de iniciar otra conexion.
  String ver;
  {
    TmCertStore roots;
    BearSSL::WiFiClientSecure c;
    c.setCertStore(&roots);
    c.setBufferSizes(1024,1024);
    c.setTimeout(12000);
    HTTPClient http;
    http.setTimeout(12000);
    if(!http.begin(c,base+"/manifest.txt")) {
      tmState="conexion_manifest";
      tmDiagnostic="http.begin fallo";
      Serial.println("[TECHMAN OTA] "+tmDiagnostic);
      return;
    }
    const int status=http.GET();
    tmHttpCode=status;
    if(status==200)ver=http.getString();
    const String error=status<0?http.errorToString(status):"";
    char tlsDetail[150]={0};
    const int sslCode=c.getLastSSLError(tlsDetail,sizeof(tlsDetail));
    http.end();
    tmDiagnostic="HTTP="+String(status)+" ssl="+String(sslCode)+" "+String(tlsDetail)+" httpErr="+error+" length="+String(ver.length());
    Serial.println("[TECHMAN OTA] "+tmDiagnostic);
  }
  // Aqui HTTPClient, BearSSL::WiFiClientSecure y certificado ya han sido destruidos.
  ver.trim();
  Serial.printf("[TECHMAN OTA] Heap despues manifest=%u maxBlock=%u frag=%u%%\n",ESP.getFreeHeap(),ESP.getMaxFreeBlockSize(),ESP.getHeapFragmentation());
  if(tmHttpCode!=200){tmState="conexion_manifest_http_"+String(tmHttpCode);return;}
  if(!tmIsVersion(ver)){tmState="contenido_manifest_invalido";return;}
  if(ver==String(TECHMAN_FW_VERSION)){tmAvailable="";tmState="actualizado";return;}
  tmAvailable=ver;
  tmState="disponible";return;
  } // final de consulta de manifiesto
  // Evitar OOM conocido antes de crear el segundo cliente TLS.
  if(ESP.getMaxFreeBlockSize()<14000){
    tmState="ram_insuficiente_ota";
    Serial.println("[TECHMAN OTA] Instalacion cancelada: RAM contigua insuficiente");
    return;
  }
  Serial.printf("[TECHMAN OTA] Descarga directa heap=%u max=%u\n", ESP.getFreeHeap(), ESP.getMaxFreeBlockSize());
  tmState="instalando";
  tmBusy=true;
  Serial.printf("[TECHMAN OTA] Iniciando firmware: heap=%u maxBlock=%u\n",ESP.getFreeHeap(),ESP.getMaxFreeBlockSize());
  TmCertStore fwRoots;
  BearSSL::WiFiClientSecure fw;
  fw.setCertStore(&fwRoots);
  fw.setBufferSizes(1024,1024);
  fw.setTimeout(20000);
  // Descargar por HTTPClient con lectura de cabecera explicitamente comprobada.
  // ESPhttpUpdate utiliza peekBytes(); con algunos servidores HTTPS este método
  // devuelve -106 al no disponer todavía de datos en el buffer BearSSL.
  HTTPClient fwHttp;
  fwHttp.useHTTP10(true);
  fwHttp.setTimeout(30000);
  fwHttp.setFollowRedirects(HTTPC_STRICT_FOLLOW_REDIRECTS);
  int fwStatus=-1;
  if(fwHttp.begin(fw,base+"/firmware.bin")) fwStatus=fwHttp.GET();
  Serial.printf("[TECHMAN OTA] Firmware HTTP=%d size=%d heap=%u bloque=%u\\n",
       fwStatus,fwHttp.getSize(),ESP.getFreeHeap(),ESP.getMaxFreeBlockSize());
  if(fwStatus!=200 || fwHttp.getSize()<100000){
    tmState="firmware_http_"+String(fwStatus);
    fwHttp.end();tmBusy=false;return;
  }
  const size_t length=(size_t)fwHttp.getSize();
  WiFiClient *stream=fwHttp.getStreamPtr();
  if(stream==nullptr){
    tmState="stream_nulo";Serial.println("[TECHMAN OTA] ERROR stream nulo");
    fwHttp.end();tmBusy=false;return;
  }
  if(ESP.getMaxFreeBlockSize()<8000){
    tmState="ram_insuficiente_descarga";
    Serial.printf("[TECHMAN OTA] Descarga abortada antes de flash: heap=%u max=%u\\n",ESP.getFreeHeap(),ESP.getMaxFreeBlockSize());
    fwHttp.end();tmBusy=false;return;
  }
  Serial.println("[TECHMAN OTA] Leyendo cabecera firmware...");
  uint8_t magic[4]={0};
  size_t got=stream->readBytes((char*)magic,4);
  Serial.printf("[TECHMAN OTA] Cabecera: recibidos=%u hex=%02X %02X %02X %02X\\n",
       (unsigned)got,magic[0],magic[1],magic[2],magic[3]);
  if(got!=4 || magic[0]!=0xE9){
    tmState="cabecera_no_valida";fwHttp.end();tmBusy=false;return;
  }
  if(!Update.begin(length,U_FLASH)){
    tmState="flash_begin_"+String(Update.getError());fwHttp.end();tmBusy=false;return;
  }
  if(Update.write(magic,4)!=4){
    tmState="flash_cabecera_"+String(Update.getError());Update.end(false);fwHttp.end();tmBusy=false;return;
  }
  size_t total=4;
  uint8_t buf[512];
  uint32_t lastData=millis();
  int lastProgress=-1;
  while(total<length){
    const size_t available=stream->available();
    if(available){
      size_t batch=min((size_t)sizeof(buf),min(available,length-total));
      int n=stream->read(buf,batch);
      if(n>0){
        if(Update.write(buf,(size_t)n)!=(size_t)n)break;
        total+=(size_t)n;lastData=millis();
        int pct=(int)(total*100UL/length);
        if(pct/10!=lastProgress){lastProgress=pct/10;Serial.printf("[TECHMAN OTA] %d%% (%u/%u)\\n",pct,(unsigned)total,(unsigned)length);}
      }
    } else if(millis()-lastData>30000UL || !stream->connected()){
      break;
    }
    delay(1);
  }
  Serial.printf("[TECHMAN OTA] Transferencia %u/%u bytes error=%u\\n",(unsigned)total,(unsigned)length,Update.getError());
  if(total==length && Update.end(true)){
    fwHttp.end();
    tmState="instalado_reiniciando";
    Serial.println("[TECHMAN OTA] Firmware validado, reiniciando");
    Serial.flush();ESP.restart();return;
  }
  tmState="transferencia_incompleta_"+String(total)+"_de_"+String(length)+"_err_"+String(Update.getError());
  Update.end(false);fwHttp.end();
  tmBusy=false;

}
static void tmTick(){
  if(tmBusy||WiFi.status()!=WL_CONNECTED||mode==AUTO||waveSearch)return;
  if(!tmRequested&&!tmInstall)return;
  bool install=tmInstall;tmLast=millis();tmRunCheck(install);
}
static void tmRoutes(){
  server.on("/api/ota/status",HTTP_GET,[](){
    if(!authorized())return;
    server.send(200,"application/json",String("{\"version\":\"")+TECHMAN_FW_VERSION+"\",\"available\":\""+tmAvailable+"\",\"state\":\""+tmState+"\",\"httpCode\":"+String(tmHttpCode)+",\"diagnostic\":\""+tmDiagnostic+"\"}");
  });
  server.on("/api/ota/check",HTTP_POST,[](){if(!authorized())return;tmRequested=true;server.send(202,"application/json","{\"queued\":true}");});
  server.on("/api/ota/install",HTTP_POST,[](){if(!authorized())return;if(mode==AUTO||waveSearch){server.send(409,"text/plain","Deten el barrido primero");return;}tmInstall=true;server.send(202,"application/json","{\"queued\":true}");});
}

